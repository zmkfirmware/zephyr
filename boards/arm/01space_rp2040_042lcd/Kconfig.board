## boards/arm/01space_rp2040_042lcd/Kconfig.board
```kconfig
# Copyright (c) 2021 Pete Johanson
# SPDX-License-Identifier: Apache-2.0

config BOARD_01SPACE_RP2040_042LCD
	bool "01Space RP2040-0.42LCD"
	depends on SOC_RP2040
```

## boards/arm/01space_rp2040_042lcd/Kconfig.defconfig
```kconfig
# Copyright (c) 2021 Pete Johanson
# SPDX-License-Identifier: Apache-2.0

if BOARD_01SPACE_RP2040_042LCD

config BOARD
	default "01space_rp2040_042lcd"

config RP2_FLASH_W25Q080
	default y

config I2C
	default y if LVGL

config SSD1306
	default y if LVGL

config SSD1306_REVERSE_MODE
	default y if SSD1306

if LVGL

config LV_Z_BITS_PER_PIXEL
	default 1

choice LV_COLOR_DEPTH
	default LV_COLOR_DEPTH_1


endchoice

endif # LVGL

endif # BOARD_01SPACE_RP2040_042LCD
```

## boards/arm/adafruit_qt_py_rp2040/Kconfig.board
```kconfig
# Copyright (c) 2021 Pete Johanson
# SPDX-License-Identifier: Apache-2.0

config BOARD_ADAFRUIT_QT_PY_RP2040
	bool "Adafruit QT Py RP2040 Board"
	depends on SOC_RP2040
```

## boards/arm/adafruit_qt_py_rp2040/Kconfig.defconfig
```kconfig
# Copyright (c) 2021 Pete Johanson
# SPDX-License-Identifier: Apache-2.0

if BOARD_ADAFRUIT_QT_PY_RP2040

config BOARD
	default "adafruit_qt_py_rp2040"

config RP2_FLASH_W25Q080
	default y

endif # BOARD_ADAFRUIT_QT_PY_RP2040
```

## boards/arm/boardsource_blok/Kconfig.board
```kconfig
# Copyright (c) 2022 Pete Johanson
# SPDX-License-Identifier: Apache-2.0

config BOARD_BOARDSOURCE_BLOK
	bool "BoardSource blok"
	depends on SOC_RP2040
```

## boards/arm/boardsource_blok/Kconfig.defconfig
```kconfig
# Copyright (c) 2021 Pete Johanson
# SPDX-License-Identifier: Apache-2.0

if BOARD_BOARDSOURCE_BLOK

config BOARD
	default "boardsource_blok"

config RP2_FLASH_W25Q080
	default y

endif # BOARD_BOARDSOURCE_BLOK
```

## boards/arm/elite_pi_rp2040/Kconfig.defconfig
```kconfig
# Copyright (c) 2021 Pete Johanson
# SPDX-License-Identifier: Apache-2.0

if BOARD_ELITE_PI_RP2040

config BOARD
	default "elite_pi_rp2040"

config RP2_FLASH_W25Q080
	default y

endif # BOARD_ELITE_PI_RP2040
```

## boards/arm/seeeduino_xiao_ble/Kconfig
```kconfig
# Seeeduino XIAO BLE board configuration

# Copyright (c) 2022 Peter Johanson
# SPDX-License-Identifier: Apache-2.0

config BOARD_ENABLE_DCDC
	bool "Enable DCDC mode"
	select SOC_DCDC_NRF52X
	default y
	depends on BOARD_SEEEDUINO_XIAO_BLE

choice BOARD_CHARGE_RATE
	prompt "LiPo Charge Rate"
	depends on BOARD_SEEEDUINO_XIAO_BLE

config BOARD_CHARGE_RATE_50MA
	bool "50mA"

config BOARD_CHARGE_RATE_100MA
	bool "100mA"

endchoice
```

## boards/arm/seeeduino_xiao_ble/Kconfig.board
```kconfig
# Seeeduino XIAO BLE board configuration

# Copyright (c) 2022 Peter Johanson
# SPDX-License-Identifier: Apache-2.0

config BOARD_SEEEDUINO_XIAO_BLE
	bool "Seeeduino XIAO BLE"
	depends on SOC_NRF52840_QIAA
```

## boards/arm/seeeduino_xiao_ble/Kconfig.defconfig
```kconfig
# Seeeduino XIAO BLE board configuration

# Copyright (c) 2022 Peter Johanson
# SPDX-License-Identifier: Apache-2.0

config BOARD
	default "seeeduino_xiao_ble" if BOARD_SEEEDUINO_XIAO_BLE

if BOARD_SEEEDUINO_XIAO_BLE

config BT_CTLR
	default BT

endif # BOARD_SEEEDUINO_XIAO_BLE
```

## boards/boardsource/blok/Kconfig.boardsource_blok
```kconfig
# Copyright (c) 2022 Pete Johanson
# SPDX-License-Identifier: Apache-2.0

config BOARD_BOARDSOURCE_BLOK
	select SOC_RP2040
```

## boards/boardsource/blok/Kconfig.defconfig
```kconfig
# Copyright (c) 2021 Pete Johanson
# SPDX-License-Identifier: Apache-2.0

if BOARD_BOARDSOURCE_BLOK

config RP2_FLASH_W25Q080
	default y

endif # BOARD_BOARDSOURCE_BLOK
```

## boards/boardsource/blok/board.yml
```yaml
board:
  name: boardsource_blok
  vendor: boardsource
  socs:
    - name: rp2040
```
